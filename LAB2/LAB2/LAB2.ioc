# file: LAB2.ioc
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Mcu.Family=STM32F1
Mcu.Name=STM32F103C6Ux
Mcu.Package=UFQFPN48
NVIC.PriorityGroup=NVIC_PRIORITYGROUP_4
NVIC.TIM2_IRQn=true\:0\:0\:false\:false\:true\:true\:true\:true
ProjectManager.HeapSize=0x200
ProjectManager.StackSize=0x400
ProjectManager.TargetToolchain=STM32CubeIDE
RCC.APB1Freq_Value=8000000
RCC.APB2Freq_Value=8000000
TIM2.Prescaler=7999
VP_SYS_VS_ND.Mode=No_Debug
VP_TIM2_VS_ClockSourceINT.Mode=Internal
board=custom

// file: Core/Src/main.c
/* USER CODE BEGIN Header */
/**
  ******************************************************************************
  * @file           : main.c
  * @brief          : Main program body
  ******************************************************************************
  * @attention
  *
  * Copyright (c) 2024 STMicroelectronics.
  * All rights reserved.
  *
  * This software is licensed under terms that can be found in the LICENSE file
  * in the root directory of this software component.
  * If no LICENSE file comes with this software, it is provided AS-IS.
  *
  ******************************************************************************
  */
/* USER CODE END Header */
#include "main.h"
#include "software_timer.h"
#include "LAB2.h"

TIM_HandleTypeDef htim2;

void SystemClock_Config(void);
static void MX_TIM2_Init(void);

int main(void)
{

  /* MCU Configuration--------------------------------------------------------*/

  /* Reset of all peripherals, Initializes the Flash interface and the Systick. */
  HAL_Init();

  /* Configure the system clock */
  SystemClock_Config();

  /* Initialize all configured peripherals */

  MX_TIM2_Init();

  /* USER CODE BEGIN 2 */

  HAL_TIM_Base_Start_IT(&htim2);
  /* USER CODE END 2 */

  /* Infinite loop */
  /* USER CODE BEGIN WHILE */

	LAB2_Init();
	setTimer0(100);

//	setTimer1(50);	int status = 0; 								//ex1
//	setTimer1(50);	setTimer2(50);				int status = 0;		//ex2
//	setTimer1(100);	const int MAX_LED = 4;	 	int index_led = 0;	//ex3
//	int index=0, MAX_LED=4, hour = 17, minute = 59, second =50;	//ex5
//	setTimer1(1); int index=0, MAX_LED=4, hour = 17, minute = 59, second =48;		//ex7
//	setTimer1(25);	setTimer2(100);	const int MAX_LED = 4;	 	int index_led = 0;	//ex8
//	setTimer1(1);	setTimer2(8); const int MAX_LED_MATRIX = 8;	int index_led_matrix = 0; //ex9_ex10

  while (1)
  {
    /* USER CODE END WHILE */
	  if(timer0_flag == 1){									//runEX0
		  setTimer0(100);
		  HAL_GPIO_TogglePin(GPIOA, LED_RED);
	  }

//	  if(timer1_flag == 1){									//runEX1
//		  setTimer1(50);
//		  switch7SEG(status);
//		  status=!status;
//	  }

//	  if(timer1_flag ==1){									//runEX2
//		  setTimer1(50);
//		  if(status>=4) status=0;
//		  switch7SEGEX2(status);
//		  status++;
//	  }
//
//	  if(timer2_flag == 1){
//		  setTimer2(100);
//		  HAL_GPIO_TogglePin(GPIOA, DOT);
//	  }

//	  if(timer1_flag == 1){									//runEX3
//		  setTimer1(100);
//		  update7SEG(index_led);
//		  index_led++;
//		  if(index_led >= MAX_LED) {
//			  index_led = 0;
//		  }
//	  }

//	  second++;
//	  if(second >= 60){										//ex5
//			minute ++;
//			second = 0;
//	  	}
//	  if(minute >=60){
//	  		hour++;
//	  		minute = 0;
//	  	}
//	  if(hour >= 24){
//		  	hour = 0;
//	  	}
//
//	  updateClockBuffer(index, hour, minute);
//	  HAL_Delay(1000);
//	  index++;
//	  if(index >= MAX_LED) index=0;

//	  if(timer1_flag==1){									//runEX7
//		  setTimer1(100);
//		  updateClockBuffer (index, hour, minute);
//		  index++;
//		  if(index>=MAX_LED) index=0;
//
//		  second++;
//		  if(second >= 60){
//			  minute ++;
//			  second = 0;
//		  }
//		  if(minute >=60){
//			  hour++;
//			  minute = 0;
//		  }
//		  if(hour >= 24){
//			  hour = 0;
//		  }
//	  }

//	  if(timer1_flag == 1){									//runEX8
//		  setTimer1(25);
//		  update7SEG(index_led);
//		  index_led++;
//		  if(index_led>=MAX_LED){
//			  index_led = 0;
//		  }
//	  }
//
//	  if(timer2_flag == 1){
//		  setTimer2(100);
//		  HAL_GPIO_TogglePin(GPIOA, DOT);
//	  }

//	  if(timer1_flag ==1){									//runEX9
//		  setTimer1(1);
//		  updateLEDMatrix(index_led_matrix);
//		  index_led_matrix++;
//		  if(index_led_matrix >=MAX_LED_MATRIX) index_led_matrix=0;
//	  }

//	  if(timer1_flag ==1){									//runEX10_bot to top
//		  setTimer1(1);
//		  updateLEDMatrix(index_led_matrix);
//		  index_led_matrix++;
//		  if(index_led_matrix >=MAX_LED_MATRIX) index_led_matrix=0;
//	  }
//
//	  if(timer2_flag == 1){
//		  setTimer2(8);
//		  updateARRAY_BOTtoTOP();
//	  }

//	  if(timer1_flag ==1){									//runEX10_left to right
//		  setTimer1(1);
//		  updateLEDMatrix_EX10(index_led_matrix);
//		  index_led_matrix++;
//		  if(index_led_matrix >=MAX_LED_MATRIX) index_led_matrix=0;
//	  }
  }
}

void SystemClock_Config(void)
{
  RCC_OscInitTypeDef RCC_OscInitStruct = {0};
  RCC_ClkInitTypeDef RCC_ClkInitStruct = {0};

  /** Initializes the RCC Oscillators according to the specified parameters
  * in the RCC_OscInitTypeDef structure.
  */
  RCC_OscInitStruct.OscillatorType = RCC_OSCILLATORTYPE_HSI;
  RCC_OscInitStruct.HSIState = RCC_HSI_ON;
  RCC_OscInitStruct.HSICalibrationValue = RCC_HSICALIBRATION_DEFAULT;
  RCC_OscInitStruct.PLL.PLLState = RCC_PLL_NONE;
  if (HAL_RCC_OscConfig(&RCC_OscInitStruct) != HAL_OK)
  {
    Error_Handler();
  }

  /** Initializes the CPU, AHB and APB buses clocks
  */
  RCC_ClkInitStruct.ClockType = RCC_CLOCKTYPE_HCLK|RCC_CLOCKTYPE_SYSCLK
                              |RCC_CLOCKTYPE_PCLK1|RCC_CLOCKTYPE_PCLK2;
  RCC_ClkInitStruct.SYSCLKSource = RCC_SYSCLKSOURCE_HSI;
  RCC_ClkInitStruct.AHBCLKDivider = RCC_SYSCLK_DIV1;
  RCC_ClkInitStruct.APB1CLKDivider = RCC_HCLK_DIV1;
  RCC_ClkInitStruct.APB2CLKDivider = RCC_HCLK_DIV1;

  if (HAL_RCC_ClockConfig(&RCC_ClkInitStruct, FLASH_LATENCY_0) != HAL_OK)
  {
    Error_Handler();
  }
}

static void MX_TIM2_Init(void)
{

  TIM_ClockConfigTypeDef sClockSourceConfig = {0};
  TIM_MasterConfigTypeDef sMasterConfig = {0};

  htim2.Instance = TIM2;
  htim2.Init.Prescaler = 7999;
  htim2.Init.CounterMode = TIM_COUNTERMODE_UP;
  htim2.Init.Period = 9;
  htim2.Init.ClockDivision = TIM_CLOCKDIVISION_DIV1;
  htim2.Init.AutoReloadPreload = TIM_AUTORELOAD_PRELOAD_DISABLE;
  if (HAL_TIM_Base_Init(&htim2) != HAL_OK)
  {
    Error_Handler();
  }
  sClockSourceConfig.ClockSource = TIM_CLOCKSOURCE_INTERNAL;
  if (HAL_TIM_ConfigClockSource(&htim2, &sClockSourceConfig) != HAL_OK)
  {
    Error_Handler();
  }
  sMasterConfig.MasterOutputTrigger = TIM_TRGO_RESET;
  sMasterConfig.MasterSlaveMode = TIM_MASTERSLAVEMODE_DISABLE;
  if (HAL_TIMEx_MasterConfigSynchronization(&htim2, &sMasterConfig) != HAL_OK)
  {
    Error_Handler();
  }

}

/* USER CODE BEGIN 4 */
//const int MAX_LED = 4;	 	int index_led = 0; //ex4
//int counter =1;
void HAL_TIM_PeriodElapsedCallback(TIM_HandleTypeDef *htim)
{
		timer_run();

//	counter--;						//EX1
//	if(counter<=0){
//		counter = 100;
//	}
//		if(counter == 100){
//			setEN(0);
//			display7SEG(1);
//		}
//		if(counter == 50){
//			setEN(1);
//			display7SEG(2);
//		}

//	counter--;						//ex2
//	if(counter <=0){
//		counter =200;
//	}
//	if(counter == 200 ){
//		setEN(0);
//		display7SEG(1);
//	}
//	if(counter == 150 ){
//		setEN(1);
//		display7SEG(2);
//	}
//	if(counter == 100 ){
//		setEN(2);
//		display7SEG(3);
//	}
//	if(counter == 50 ){
//		setEN(3);
//		display7SEG(0);
//	}

//	counter--;						//ex3
//	if(counter <= 0) {
//		counter =100;
//		update7SEG(index_led);
//		index_led++;
//		if(index_led >= MAX_LED) {
//			index_led = 0;
//		  }
//	}

//	counter--;						//ex4
//		if(counter <= 0) {
//			counter =25;
//			update7SEG(index_led);
//			index_led++;
//			if(index_led >= MAX_LED) {
//				index_led = 0;
//				HAL_GPIO_TogglePin(GPIOA, DOT);
//			  }
//		}

}
/* USER CODE END 4 */

void Error_Handler(void)
{
  __disable_irq();
  while (1)
  {
  }
}
